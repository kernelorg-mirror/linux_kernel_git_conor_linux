// SPDX-License-Identifier: (GPL-2.0-only OR BSD-3-Clause)
/*
 * Copyright 2026 NXP
 *
 * OpenHW Group CVA6 APU, 64-bit core (cv64a6), on the Digilent Genesys 2.
 */

/dts-v1/;

#include "cva6-genesys2.dtsi"

/ {
	model = "OpenHW Group CVA6 cv64a6 on Digilent Genesys 2";
	compatible = "openhwgroup,cv64a6-genesys2-v5.3.0",
		     "openhwgroup,cva6-apu-v5.3.0";

	memory@80000000 {
		device_type = "memory";
		/* 1 GiB of DDR3, as configured for this core by the FPGA build */
		reg = <0x0 0x80000000 0x0 0x40000000>;
	};
};

&cpu0 {
	compatible = "openhwgroup,cv64a6", "riscv";
	riscv,isa-base = "rv64i";
	riscv,isa-extensions = "i", "m", "a", "f", "d", "c", "b", "zba",
			       "zbb", "zbc", "zbkb", "zbkc", "zbkx", "zbs",
			       "zca", "zcb", "zcd", "zicntr", "zicond", "zicsr",
			       "zifencei", "zihpm", "zknd", "zkne", "zknh";
	mmu-type = "riscv,sv39";
};
